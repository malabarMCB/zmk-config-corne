/ {
    macros {
        lm: lm {
            compatible = "zmk,behavior-macro-two-param";
            #binding-cells = <2>;
            bindings = <&macro_param_1to1>, <&macro_press &mo MACRO_PLACEHOLDER>,
                <&macro_param_2to1>, <&macro_press &sk MACRO_PLACEHOLDER>,
                <&macro_pause_for_release>,
                <&macro_param_2to1>, <&macro_release &sk MACRO_PLACEHOLDER>,
                <&macro_param_1to1>, <&macro_release &mo MACRO_PLACEHOLDER>;
        };

        slm: slm {
            compatible = "zmk,behavior-macro-two-param";
            #binding-cells = <2>;
            bindings = <&macro_param_1to1>, <&macro_press &sl MACRO_PLACEHOLDER>,
                <&macro_param_2to1>, <&macro_press &sk MACRO_PLACEHOLDER>,
                <&macro_pause_for_release>,
                <&macro_param_2to1>, <&macro_release &sk MACRO_PLACEHOLDER>,
                <&macro_param_1to1>, <&macro_release &sl MACRO_PLACEHOLDER>;
        };
    };
};